#include <tinyml.h>

Eloquent::TF::Sequential<TF_NUM_OPS, ARENA_SIZE> tf;

// 20250311 shoulder classification model 0.89 (with augmentations)
float positive[270] = { -0.4970, -0.5071, 0.5794, -0.4361, -1.2353, -0.4970, -0.5339, -0.8133, 1.0425, -0.4529, -0.4963, 0.5533, -0.4394,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 -1.9600, -0.7019};
float positive1[270] = { -1.1576, -0.5360, 0.6120, -0.6389, -0.9585, -0.5755, -0.2087, -0.6020, 1.2628, -1.1869, -0.4874, 0.6002, -0.4258,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 -1.3992, -0.5696 };
float positive2[270] = { -1.0338, 0.0334, 0.2557, 0.3389, -0.9288, -0.1110, 0.0270, 0.0335, 1.0609, -1.0452, -0.4973, -0.2302, -0.0520,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 -2.9361, 0.7483 };
float positive3[270] = { -1.0296, -0.2877, 0.3810, -0.3360, -0.7931, -0.3009, -0.0253, -0.4355, 1.3128, -1.0605, -0.2178, 0.3471, -0.1419,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 -1.5553, 0.4642 };
float negative1[270] = { 1.2995, -0.1794, -0.1563, 0.2364, -0.3786, 0.0817, -0.4355, 0.0552, -0.5277, 1.1573, -0.3648, -0.2614, 0.2638,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 0.1267, -0.8807 };
float negative2[270] = { 1.4063, -0.5614, -0.2738, -0.4168, 1.2938, -0.2009, 0.0417, -1.3234, 0.5988, 1.4918, -1.2494, 0.1077, -0.7180,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 -1.4294, -0.5080 };
float negative3[270] = { -1.9703, 0.4221, 0.8061, -0.4066, 0.5887, -0.8795, 0.8316, -0.5777, -1.3096, -1.6469, -0.0905, 0.4322, -0.2026,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 0.4181, 1.2997 };


void predictSample(const char *classLabel, float *input, uint8_t expectedOutput) {
    // classify class 0
    if (!tf.predict(input).isOk()) {
        extern HardwareSerial DebugSerial;
        DebugSerial.println(tf.exception.toString());
        return;
    }

    extern HardwareSerial DebugSerial;
    DebugSerial.print("Predicting sample of ");
    DebugSerial.print(classLabel);
    DebugSerial.print(": expcted id=");
    DebugSerial.print(expectedOutput);
    DebugSerial.print(", predicted=");
    DebugSerial.println(tf.classification);

}

void tinyMLExample() {
    predictSample("positive0", positive, 1);
    predictSample("positive1", positive1, 1);
    predictSample("positive2", positive2, 1);
    predictSample("positive3", positive3, 1);
    predictSample("negative1", negative1, 0);
    predictSample("negative2", negative2, 0);
    predictSample("negative3", negative3, 0);

    // how long does it take to run a single prediction?
    DebugSerial.print("It takes ");
    DebugSerial.print(tf.benchmark.microseconds());
    DebugSerial.println("us for a single prediction");

    delay(1000);
}


void initTinyML() {
    // Serial.begin(115200);
    // delay(3000);
    DebugSerial.println("__TENSORFLOW__");

    // configure input/output
    // (not mandatory if you generated the .h model
    // using the eloquent_tensorflow Python package)
    tf.setNumInputs(TF_NUM_INPUTS);
    DebugSerial.println("__INPUTS SET__");
    tf.setNumOutputs(TF_NUM_OUTPUTS);
    DebugSerial.println("__OUTPUTS SET__");

    registerNetworkOps(tf);
    DebugSerial.println("__NETWORKOPS SET__");

    while (!tf.begin(tfModel).isOk()) {
        DebugSerial.println(tf.exception.toString());
        delay(1000);
    }

    tinyMLExample();
}

float scaleValue(float x, float minVal, float maxVal, float targetMin, float targetMax) {
    return ((x - minVal) / (maxVal - minVal)) * (targetMax - targetMin) + targetMin;
}

std::vector<float> normalization(int16_t* data) {
    std::vector<float> scaledData(TINYML_BUFFER_LEN, 0.0f);

    float mean = 0;
    for (int i = 0; i < TINYML_BUFFER_LEN; i++) {
        mean += data[i];
    }
    mean /= TINYML_BUFFER_LEN;

    float variance = 0;
    for (int i = 0; i < TINYML_BUFFER_LEN; i++) {
        variance += pow((data[i] - mean), 2);
    }
    variance /= TINYML_BUFFER_LEN;  // Variance of the middle half

    float std = sqrt(variance);

    // Serial.println("");
    // Scale the data
    if (std > 0) {
        for (int i = 0; i < TINYML_BUFFER_LEN; i++) {
            scaledData[i] = (data[i] - mean)/std;
        }
    }
    // Serial.println("");
    return scaledData;
}

uint8_t tinyMLInference(tinyMLDataClass predictionInput) {
    uint8_t prediction = 0;

/// NOTE: need to check if these are correct in L or R
    std::vector<float> ADS3 = normalization(predictionInput.adsRBuffer);
    std::vector<float> IMU3_x = normalization(predictionInput.gyroRXBuffer);
    std::vector<float> IMU3_y = normalization(predictionInput.gyroRYBuffer);
    std::vector<float> IMU3_z = normalization(predictionInput.gyroRZBuffer);
    std::vector<float> ADS1 = normalization(predictionInput.adsLBuffer);
    std::vector<float> IMU1_x = normalization(predictionInput.gyroLXBuffer);
    std::vector<float> IMU1_y = normalization(predictionInput.gyroLYBuffer);
    std::vector<float> IMU1_z = normalization(predictionInput.gyroLZBuffer); 
    std::vector<float> TOF = normalization(predictionInput.tofBuffer);

    float flattenedInput[TINYML_BUFFER_LEN*9];
    int inputIndex = 0;

#ifdef ROW_WISE_FLATTENING
    for (int j = 0; j < TINYML_BUFFER_LEN; j++) {
        flattenedInput[inputIndex++] = ADS1[j];
        flattenedInput[inputIndex++] = IMU1_x[j];
        flattenedInput[inputIndex++] = IMU1_y[j];
        flattenedInput[inputIndex++] = IMU1_z[j];
        flattenedInput[inputIndex++] = ADS3[j];
        flattenedInput[inputIndex++] = IMU3_x[j];
        flattenedInput[inputIndex++] = IMU3_y[j];
        flattenedInput[inputIndex++] = IMU3_z[j];
        flattenedInput[inputIndex++] = TOF[j];
    }
#else
    for (int j = 0; j < TINYML_BUFFER_LEN; j++) {
        flattenedInput[inputIndex++] = ADS1[j];
    }
    for (int j = 0; j < TINYML_BUFFER_LEN; j++) {
        flattenedInput[inputIndex++] = IMU1_x[j];
    }
    for (int j = 0; j < TINYML_BUFFER_LEN; j++) {
        flattenedInput[inputIndex++] = IMU1_y[j];
    }
    for (int j = 0; j < TINYML_BUFFER_LEN; j++) {
        flattenedInput[inputIndex++] = IMU1_z[j];
    }
    for (int j = 0; j < TINYML_BUFFER_LEN; j++) {
        flattenedInput[inputIndex++] = ADS3[j];
        // Serial.printf("%f, ", ADS3[j]);
    }
    // Serial.println("");
    for (int j = 0; j < TINYML_BUFFER_LEN; j++) {
        flattenedInput[inputIndex++] = IMU3_x[j];
    }
    for (int j = 0; j < TINYML_BUFFER_LEN; j++) {
        flattenedInput[inputIndex++] = IMU3_y[j];
    }
    for (int j = 0; j < TINYML_BUFFER_LEN; j++) {
        flattenedInput[inputIndex++] = IMU3_z[j];
    }
    for (int j = 0; j < TINYML_BUFFER_LEN; j++) {
        flattenedInput[inputIndex++] = TOF[j];
    }
#endif

#ifdef PRINT_PREDICTION_DATA
    extern HardwareSerial DebugSerial;
    DebugSerial.println("------");
    for (int j=0; j<TINYML_BUFFER_LEN*9; j++) {
        DebugSerial.printf("%f, ", flattenedInput[j]);
    }
    DebugSerial.println("------");
#endif

    if (!tf.predict(flattenedInput).isOk()) {
        extern HardwareSerial DebugSerial;
        DebugSerial.printf("SOMETHING WRONG WITH MODEL INFERENCE");
        DebugSerial.println(tf.exception.toString());
        return 0;
    }
    prediction = tf.classification;
    extern HardwareSerial DebugSerial;
    DebugSerial.print("predicted=");
    DebugSerial.println(tf.classification);

    return prediction;
}
